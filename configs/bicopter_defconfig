## configs/bicopter_defconfig
```kconfig
CONFIG_PLATFORM_BICOPTER=y

CONFIG_ESTIMATOR_AUTO_SELECT=y
CONFIG_CONTROLLER_LEE=y

CONFIG_MOTORS_REQUIRE_ARMING=y

CONFIG_MOTORS_ESC_PROTOCOL_DSHOT=y
CONFIG_MOTORS_DSHOT_PWM_300KHZ=y

CONFIG_DECK_BICOPTER=y
CONFIG_DECK_FORCE="bicopterDeck"

CONFIG_ENABLE_THRUST_BAT_COMPENSATED=n
```
